## gatt_server_service_table/main/Kconfig.projbuild
```kconfig
menu "RPI-I Project Configuration"

    config EXAMPLE_SSID_SET_MAC
        bool "Use MAC as SSID"
        default y
        help
            Set SoftAP SSID as PROV_<MAC>.

    config EXAMPLE_SSID
        string "Wi-Fi SSID"
        default "PROV_SSID"
        depends on !EXAMPLE_SSID_SET_MAC
        help
            SSID (network name) for the example to connect to.

    config EXAMPLE_PASS
        string "Wi-Fi Password"
        default "PROV_PASS"
        help
            Wi-Fi password (WPA or WPA2) for the example to use.

    config EXAMPLE_USE_SEC_1
        bool
        default y
        prompt "Use Security Version 1"
        help
            Security version 1 used Curve25519 key exchange for establishing
            secure session between device and client during provisioning

    config EXAMPLE_USE_POP
        bool
        depends on EXAMPLE_USE_SEC_1
        default y
        prompt "Use proof-of-possession"
        help
            Proof-of-possession can be optionally used to prove that the device is indeed
            in possession of the user who is provisioning the device. This proof-of-possession
            is internally used to generate the shared secret through key exchange.

    config EXAMPLE_POP
        string "Proof-of-possession"
        default "abcd1234"
        depends on EXAMPLE_USE_POP

    config EXAMPLE_RESET_PROVISIONED
        bool
        default n
        prompt "Reset provisioned status of the device"
        help
            This erases the NVS to reset provisioned status of the device on every reboot.
            Provisioned status is determined by the Wi-Fi STA configuration, saved on the NVS.

    config EXAMPLE_AP_RECONN_ATTEMPTS
        int "Maximum AP connection attempts"
        default 5
        help
            Set the maximum connection attempts to perform when connecting to a Wi-Fi AP.

    config MEASUREMENT_FREQUENCY
        string "Time interval between measurements (seconds)"
        default "2.0"
        help
            The different parameters are measured periodically
            according to this parameter.

    config DISTANCE
        string "Distance for people detection (meters)"
        default "1.5"
        help
            The detected devices are counted only if their estiamted distance
            is less than this value.

    config ACTIVATE_CE_MEASUREMENT
        bool
        default y
        prompt "Activate initial measurement of people estimation"
        help
            People estimation is measured when the applications starts.

    config ACTIVATE_CO2_MEASUREMENT
        bool
        default y
        prompt "Activate initial measurement of CO2"
        help
            CO2 is measured when the applications starts.

    config ACTIVATE_TMP_MEASUREMENT
        bool
        default y
        prompt "Activate initial measurement of temperature"
        help
            Temperature is measured when the applications starts.

    choice ESTIMATION_TECHNIQUE
        bool "Estimation Technique"
        default ESTIMATION_TECHNIQUE_1
        help
            Technique used for Distance Estimation via RSSI. Choose any one.

        config ESTIMATION_TECHNIQUE_1
            bool "Generic log-distance"
            help
                General method for RSSI-based distance estimation.

        config ESTIMATION_TECHNIQUE_2
            bool "AltBeacon"
            help
                Well-suited for indoor locations.

    endchoice

    config MEASURED_POWER
        int "Measured power of the devices"
        default -57
        help
            Set the measured power of the devices used for RSSI-based distance estimation.

    config AMBIENTAL_PARAM
        string "Ambiental parameter"
        depends on ESTIMATION_TECHNIQUE_1
        default "2.5"
        help
            Set the ambiental parameter used for RSSI-based distance estimation.

endmenu
```
